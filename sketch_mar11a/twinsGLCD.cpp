#include "Arduino.h"
#include "twinsGLCD.h"


unsigned int buff[16][32];

#ifdef twinsGLCD_h
 const char font[] PROGMEM  = {
  0x00, 0x00, 0x00, 0x00, 0x00,
  0x3E, 0x5B, 0x4F, 0x5B, 0x3E,
  0x3E, 0x6B, 0x4F, 0x6B, 0x3E,
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  0xff, 0xff, 0xff, 0xff, 0xff,
  
};


void twinsGLCD::writeBuff(int X, int Y, unsigned char nilai){
  if(_rotate==0){
  X=127-X;
  Y=63-Y;
  }
  if(Y<32){
    if(nilai)buff[X/16][Y]|=(1<<(15-(X%16)));
    else {buff[X/16][Y]&=~(1<<(15-(X%16)));}
  }
  else{
    if(nilai)buff[X/16+8][Y-32]|=(1<<(15-(X%16)));
    else{buff[X/16+8][Y-32]&=~(1<<(15-(X%16)));}
  }
}

#endif
twinsGLCD::twinsGLCD(int rs, int rw, int e, int d4, int d5, int d6, int d7,int ps8, int rst){
 // init(rs,rw,e,d4,d5,d6,d7,ps8,rst);  
  _rs=rs;
  _rw=rw;
  _en=e;
  _d4=d4;
  _d5=d5;
  _d6=d6;
  _d7=d7;
  _ps8=ps8;
  _rst=rst;
  _rotate=0;
  _fontsize=1;
  pinMode(_ps8,OUTPUT);
  pinMode(_rst,OUTPUT);
  pinMode(_rs,OUTPUT);
  pinMode(_en,OUTPUT);
  pinMode(_rw,OUTPUT);
  pinMode(_d4,OUTPUT);
  pinMode(_d5,OUTPUT);
  pinMode(_d6,OUTPUT);
  pinMode(_d7,OUTPUT);
  isPS8=1;

  //this->init();
  /*

  */
}
twinsGLCD::twinsGLCD(int rs, int rw, int e, int d4, int d5, int d6, int d7, int rst){
 // init(rs,rw,e,d4,d5,d6,d7,ps8,rst);  
    _rs=rs;
  _rw=rw;
  _en=e;
  _d4=d4;
  _d5=d5;
  _d6=d6;
  _d7=d7;
  _rst=rst;
  isPS8=0;
  //pinMode(_ps8,OUTPUT);
  pinMode(_rst,OUTPUT);
  pinMode(_rs,OUTPUT);
  pinMode(_en,OUTPUT);
  pinMode(_rw,OUTPUT);
  pinMode(_d4,OUTPUT);
  pinMode(_d5,OUTPUT);
  pinMode(_d6,OUTPUT);
  pinMode(_d7,OUTPUT);
  //this->init();
  /*

  */
}

void twinsGLCD::setRotate(int a){
  _rotate=a;
}
void twinsGLCD::init(){
  int x,y;
  if(isPS8)
    digitalWrite(_ps8,HIGH);
    digitalWrite(_rst,HIGH); 
    digitalWrite(_rst,LOW);
    delay(5); 
    digitalWrite(_rst,HIGH);

  
  writeCommand(0b00100000); // function set, 4 bit mode
  delay(5);
  writeCommand(0b00100000); // 4 bit mode again
  delay(5);
  writeCommand(0b00001100); // display on, cursor off, blink off
  delay(5);
  writeCommand(0x01);     // display clear
  delay(5);
  writeCommand(0x06);     // Cursor moves right, no display shift.  
  delay(5);
  writeCommand(0b00000010); // Returns to home. Cursor moves to 
  writeCommand(0x20);   
  delay(1);
  writeCommand(0x24);     // Switch to extended   
  delay(1);
  writeCommand(0x26);     // Enable graphics mode.
  delay(1);

  
  for(x=0;x<16;x++)
    for(y=0;y<32;y++){
        if(x<8)
        buff[x][y]=0x0;
      else
        buff[x][y]=0;
    }

}
void twinsGLCD::data(char c){
  if(c&(1<<0))digitalWrite(_d4,HIGH); else {digitalWrite(_d4,LOW);}
  if(c&(1<<1))digitalWrite(_d5,HIGH); else {digitalWrite(_d5,LOW);}
  if(c&(1<<2))digitalWrite(_d6,HIGH); else {digitalWrite(_d6,LOW);}
  if(c&(1<<3))digitalWrite(_d7,HIGH); else {digitalWrite(_d7,LOW);}
}
void twinsGLCD::writeCommand(char c){
  digitalWrite( _rs,LOW);
  digitalWrite( _rw,LOW);
  digitalWrite( _en,1);
//  delayMicroseconds(20);
    data(c>>4);
//  delayMicroseconds(20);
  digitalWrite( _en,0);
  digitalWrite( _en,1);
//  delayMicroseconds(20);
    data(c&0xf);
//  delayMicroseconds(20);
  digitalWrite( _en,0);
  
}

void twinsGLCD::writeData(char c){
  digitalWrite( _rs,HIGH);
  digitalWrite( _rw,LOW);
  digitalWrite( _en,1);
//    delayMicroseconds(20);

    data(c>>4);
//    delayMicroseconds(20);

  digitalWrite( _en,0);
  digitalWrite( _en,1);
//  delayMicroseconds(20);
  data(c&0xf);
//  delayMicroseconds(20);

  digitalWrite( _en,0);
  
}


void twinsGLCD::draw(char *a,int x, int y){
 int k,i,j,data;

   for(k=0;k<y;k++)
  for(i=0;i<8;i++)
   for(j=0;j<x;j++){
    data= *(a+j+(k*x));
     if(data&(1<<i))
      this->writeBuff(_xCursor+j,_yCursor+(k*8)+i,1);
     else
      this->writeBuff(_xCursor+j,_yCursor+(k*8)+i,0);
   }
}

void twinsGLCD::drawProgmem(int a,int x, int y){
 int k,i,j,data;

   for(k=0;k<y;k++)
  for(i=0;i<8;i++)
   for(j=0;j<x;j++){
    data= pgm_read_byte_near(a+j+(k*x));
     if(data&(1<<i))
      this->writeBuff(_xCursor+j,_yCursor+(k*8)+i,1);
     else
      this->writeBuff(_xCursor+j,_yCursor+(k*8)+i,0);
   }
}

void twinsGLCD::write(char a){
  int i,j,k,kk; 
  char x;
  int data;
  
  data= ((int)font+(a*5));
  //cout<<(int)*(data)<<","<<(int)*(data+1)<<","<<(int)*(data+2)<<","<<(int)*(data+3)<<","<<(int)*(data+4);
  for(j=0;j<8;j++)
    for(kk=0;kk<_fontsize;kk++){
    for(i=0;i<6;i++){
     for(k=0;k<(_fontsize+_bold);k++){
       if(i<5){
         x=pgm_read_byte_near(data+i);
       }
       else{
        x=0;
       }
       if(x &(1<<j)){
        this->writeBuff(_xCursor+(i*(_fontsize+_bold))+k ,_yCursor+(j*_fontsize)+kk,1);
       }
       else {this->writeBuff(_xCursor+(i*(_fontsize+_bold))+k ,_yCursor+(j*_fontsize)+kk,0);}
     }
    }
    }
   _xCursor+=(6*(_fontsize+_bold));
}

void twinsGLCD::display(void){
  unsigned char x, y;
  
  for(y = 0; y < 32; y++)
  {

    for(x = 0; x < 16; x++)
    {
      writeCommand(0x80 | y);
      writeCommand(0x80+x);
      writeData(buff[x][y]>>8);
      writeData(buff[x][y]&0xff);
    }
  }


}

void twinsGLCD::rutinDisplay(void){
  
  static unsigned char y,x;
  int k;
  
  for(k=0;k<2;k++){
      
      
    x++;
    if(x>=16){
      x=0;
      y++;
      if(y>=32)y=0;
    }
    
      writeCommand(0x80 | y);
      writeCommand(0x80+x);
      writeData(buff[x][y]>>8);
      writeData(buff[x][y]&0xff);
    
  }


}
void twinsGLCD::print(char *a){
  while(*a){
    write(*a);
    a++;
  }
}

void twinsGLCD::setCursor(int x, int y){
 _xCursor=x;
 _yCursor=y;
} 

void twinsGLCD::setFontSize(int size){
_fontsize= size;
}

void twinsGLCD::setBold(int a){
 _bold = a; 
}

void twinsGLCD::clear(){
  for(int x=0;x<16;x++)
    for(int y=0;y<32;y++)
      buff[x][y]=0;
}

void twinsGLCD::writeCustom(unsigned char *ini){
  int i,j,k,kk; 
  char x;
  
  //cout<<(int)*(data)<<","<<(int)*(data+1)<<","<<(int)*(data+2)<<","<<(int)*(data+3)<<","<<(int)*(data+4);
  for(j=0;j<8;j++)
    for(kk=0;kk<_fontsize;kk++){
    for(i=0;i<6;i++){
     for(k=0;k<(_fontsize+_bold);k++){
       if(i<5){
         x=*(ini+i);
       }
       else{
        x=0;
       }
       if(x &(1<<j)){
        this->writeBuff(_xCursor+(i*(_fontsize+_bold))+k ,_yCursor+(j*_fontsize)+kk,1);
       }
       else {this->writeBuff(_xCursor+(i*(_fontsize+_bold))+k ,_yCursor+(j*_fontsize)+kk,0);}
     }
    }
    }
   _xCursor+=(6*(_fontsize+_bold));
}

void twinsGLCD::clearRow(unsigned char row){
  

}

void twinsGLCD::drawLine(char line){
    for(int x=0;x<128;x++){
      this->writeBuff(x,line,1);
    }
}


void buffset(unsigned int *a,unsigned char nilai, int mount){
  int i;
  for(i=0;i<mount;i++){
    *(a+i)=nilai;
  }
}
